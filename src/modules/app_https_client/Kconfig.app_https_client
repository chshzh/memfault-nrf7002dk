## src/modules/app_https_client/Kconfig.app_https_client
```kconfig
#
# Copyright (c) 2026 Nordic Semiconductor ASA
#
# SPDX-License-Identifier: LicenseRef-Nordic-5-Clause
#

config APP_HTTPS_CLIENT_ENABLED
	bool "Enable periodic HTTPS client requests"
	default n
	help
	  Enable application HTTPS client that sends periodic HEAD requests
	  to a configured hostname.

if APP_HTTPS_CLIENT_ENABLED

config APP_HTTPS_HOSTNAME
	string "HTTPS hostname"
	default "example.com"
	help
	  The hostname to send HTTPS requests to.

config APP_HTTPS_REQUEST_INTERVAL_SEC
	int "HTTPS request interval in seconds"
	default 10
	help
	  The interval between periodic HTTPS requests.

config APP_HTTPS_CLIENT_STACK_SIZE
	int "HTTPS client thread stack size"
	default 6144
	help
	  Stack size for the HTTPS client thread.

config APP_HTTPS_CLIENT_THREAD_PRIORITY
	int "HTTPS client thread priority"
	default 5
	help
	  Priority of the HTTPS client thread.

module = APP_HTTPS_CLIENT
module-str = app_https_client
source "subsys/logging/Kconfig.template.log_config"

endif # APP_HTTPS_CLIENT_ENABLED
```

## src/modules/app_mqtt_client/Kconfig.app_mqtt_client
```kconfig
#
# Copyright (c) 2026 Nordic Semiconductor ASA
#
# SPDX-License-Identifier: LicenseRef-Nordic-5-Clause
#

config APP_MQTT_CLIENT_ENABLED
	bool "Enable MQTT client with TLS"
	depends on MQTT_HELPER
	depends on HW_ID_LIBRARY
	default n
	help
	  Enable application MQTT client (TLS, echo test). Uses mqtt_helper library.

if APP_MQTT_CLIENT_ENABLED

config APP_MQTT_CLIENT_BROKER_HOSTNAME
	string "MQTT broker hostname"
	default "test.mosquitto.org"
	help
	  The hostname of the MQTT broker to connect to.

config APP_MQTT_CLIENT_PUBLISH_TOPIC
	string "MQTT publish topic suffix"
	default "count"
	help
	  The topic suffix for publishing messages.

config APP_MQTT_CLIENT_PUBLISH_INTERVAL_SEC
	int "MQTT publish interval in seconds"
	default 60
	help
	  The interval between periodic MQTT message publishes.

config APP_MQTT_CLIENT_RECONNECT_TIMEOUT_SEC
	int "MQTT reconnection timeout in seconds"
	default 60
	help
	  Time between reconnection attempts to the MQTT broker.

config APP_MQTT_CLIENT_STACK_SIZE
	int "MQTT client thread stack size"
	default 4096
	help
	  Stack size for the MQTT client thread.

config APP_MQTT_CLIENT_THREAD_PRIORITY
	int "MQTT client thread priority"
	default 5
	help
	  Priority of the MQTT client thread.

config APP_MQTT_CLIENT_ID_BUFFER_SIZE
	int "MQTT client ID buffer size"
	default 50
	help
	  Size of buffer used to store the MQTT client ID.

module = APP_MQTT_CLIENT
module-str = app_mqtt_client
source "subsys/logging/Kconfig.template.log_config"

endif # APP_MQTT_CLIENT_ENABLED
```

## src/modules/ble_prov/Kconfig.ble_prov
```kconfig
#
# Copyright (c) 2026 Nordic Semiconductor ASA
#
# SPDX-License-Identifier: LicenseRef-Nordic-5-Clause
#

config BLE_PROV_ENABLED
	bool "Enable BLE provisioning for WiFi credentials"
	depends on BT_WIFI_PROV
	default n
	help
	  Enable Bluetooth LE based WiFi provisioning.
	  WiFi credentials can be configured via nRF Wi-Fi Provisioner app.

if BLE_PROV_ENABLED

module = BLE_PROV
module-str = ble_prov
source "subsys/logging/Kconfig.template.log_config"

endif # BLE_PROV_ENABLED
```

## src/modules/wifi/Kconfig.wifi
```kconfig
#
# Copyright (c) 2026 Nordic Semiconductor ASA
#
# SPDX-License-Identifier: LicenseRef-Nordic-5-Clause
#

config WIFI_MODULE
	bool "WiFi STA Module"
	default y
	help
	  Enable WiFi station module with SMF state machine.
	  Uses conn_mgr API; publishes WIFI_CHAN on connect/disconnect.

if WIFI_MODULE

module = WIFI_MODULE
module-str = wifi_module
source "subsys/logging/Kconfig.template.log_config"

endif # WIFI_MODULE
```

## sysbuild/mcuboot/boards/nrf7002dk_nrf5340_cpuapp.conf
```kconfig
#
# Copyright (c) 2023 Nordic Semiconductor ASA
#
# SPDX-License-Identifier: LicenseRef-Nordic-5-Clause
#

# nRF7002DK uses SPI NOR external flash
CONFIG_GPIO=y
CONFIG_SPI=y
CONFIG_SPI_NOR=y
CONFIG_SPI_NOR_SFDP_DEVICETREE=y
CONFIG_SPI_NOR_FLASH_LAYOUT_PAGE_SIZE=4096
# QSPI drivers are enabled by defualt for some chips.
# Disable it explicitly to be sure QSPI is disabled.
CONFIG_NORDIC_QSPI_NOR=n
CONFIG_PM_OVERRIDE_EXTERNAL_DRIVER_CHECK=y

# required by SPI driver
CONFIG_MULTITHREADING=y
```
