## CMakeLists.txt
```
#
# Copyright (c) 2021 Nordic Semiconductor
#
# SPDX-License-Identifier: LicenseRef-Nordic-5-Clause
#

cmake_minimum_required(VERSION 3.20.0)

find_package(Zephyr REQUIRED HINTS $ENV{ZEPHYR_BASE})
project(memfault-nrf7002dk)

# Generate hex files from pem files for app HTTPS client
if(CONFIG_APP_HTTPS_CLIENT_ENABLED)
    set(gen_dir ${CMAKE_CURRENT_BINARY_DIR}/certs)
    zephyr_include_directories(${gen_dir})
    generate_inc_file_for_target(
        app
        src/modules/app_https_client/cert/SSLcom-TLS-Root-2022-ECC.pem
        ${gen_dir}/SSLcom-TLS-Root-2022-ECC.pem.inc
    )
endif()


zephyr_include_directories(${CMAKE_CURRENT_SOURCE_DIR}/src)
zephyr_include_directories(${CMAKE_CURRENT_SOURCE_DIR}/src/modules/memfault/config)

target_sources(app PRIVATE src/main.c)

# Module subdirectories (SMF+zbus modular architecture)
add_subdirectory(src/modules/button)
add_subdirectory(src/modules/wifi)
add_subdirectory(src/modules/ble_prov)
add_subdirectory(src/modules/memfault)
add_subdirectory(src/modules/app_https_client)
add_subdirectory(src/modules/app_mqtt_client)

# Add BLE provisioning library when enabled
if(CONFIG_BLE_PROV_ENABLED)
    zephyr_library_include_directories($<TARGET_PROPERTY:wifi_prov_core,BINARY_DIR>)
    target_link_libraries(app PRIVATE wifi_prov_ble)
endif()
```

## Kconfig
```
#
# Copyright (c) 2021 Nordic Semiconductor ASA
#
# SPDX-License-Identifier: LicenseRef-Nordic-5-Clause
#

menu "Memfault nRF7002DK"

module = MEMFAULT_SAMPLE
module-str = Memfault sample
source "${ZEPHYR_BASE}/subsys/logging/Kconfig.template.log_config"

rsource "src/modules/button/Kconfig.button"
rsource "src/modules/wifi/Kconfig.wifi"
rsource "src/modules/ble_prov/Kconfig.ble_prov"
rsource "src/modules/memfault/Kconfig.memfault"
rsource "src/modules/app_https_client/Kconfig.app_https_client"
rsource "src/modules/app_mqtt_client/Kconfig.app_mqtt_client"

endmenu

source "Kconfig.zephyr"
```

## prj.conf
```kconfig
#
# Copyright (c) 2026 Nordic Semiconductor ASA
#
# SPDX-License-Identifier: LicenseRef-Nordic-5-Clause
# 
# Configuration coverage priority:
# Command line > Overlay files > project boards/<board>.conf > prj.conf > Board defconfig
# (highest)                                                              (lowest)

CONFIG_MEMFAULT_SAMPLE_LOG_LEVEL_INF=y

# Nordic-specific Memfault integrations
CONFIG_MEMFAULT_NCS_FW_VERSION_STATIC=y
CONFIG_MEMFAULT_NCS_FW_VERSION="2.4.1"
# Placeholder so build/CI succeeds without overlay; use overlay-project-key.conf for real key.
CONFIG_MEMFAULT_NCS_PROJECT_KEY="dummy-key"
CONFIG_MEMFAULT_METRICS_HEARTBEAT_INTERVAL_SECS=60
CONFIG_MEMFAULT_HTTP_PERIODIC_UPLOAD_INTERVAL_SECS=60
CONFIG_MEMFAULT_NCS_IMPLEMENT_METRICS_COLLECTION=n
CONFIG_MEMFAULT_NCS_BT_METRICS=n
CONFIG_MEMFAULT_NCS_LTE_METRICS=n
CONFIG_MEMFAULT_NCS_STACK_METRICS=y

# Memfault Core Configurations
CONFIG_MEMFAULT=y
CONFIG_MEMFAULT_LOGGING_ENABLE=y
CONFIG_MEMFAULT_LOGGING_RAM_SIZE=8192
CONFIG_MEMFAULT_LOG_LEVEL_INF=y
CONFIG_MEMFAULT_NCS_LOG_LEVEL_INF=y
# CONFIG_MEMFAULT_LOG_LEVEL_DBG=y
# CONFIG_MEMFAULT_NCS_LOG_LEVEL_DBG=y
CONFIG_MEMFAULT_SHELL=y
CONFIG_MEMFAULT_FOTA_CLI_CMD=y
CONFIG_MEMFAULT_HTTP_ENABLE=y
CONFIG_MEMFAULT_HTTP_PERIODIC_UPLOAD=y
# CONFIG_MEMFAULT_HTTP_PERIODIC_UPLOAD_INTERVAL_SECS=900
CONFIG_MEMFAULT_HTTP_PERIODIC_UPLOAD_LOGS=y
CONFIG_MEMFAULT_COREDUMP_FULL_THREAD_STACKS=n
CONFIG_MEMFAULT_COREDUMP_COLLECT_BSS_REGIONS=n
CONFIG_MEMFAULT_NCS_INTERNAL_FLASH_BACKED_COREDUMP=y

# Memfault CDR (Custom Data Recording) - nRF70 WiFi Firmware Statistics
# WARNING: Memfault CDR is limited to 1 upload per device per 24 hours!
#          Need to check with Memfault to increase quota if more frequent uploads are needed.
# Trigger: Button 1 short press collects nRF70 FW stats (PHY, LMAC, UMAC) and uploads to cloud
CONFIG_MEMFAULT_CDR_ENABLE=y
CONFIG_NRF70_FW_STATS_CDR_ENABLED=y

# Memfault Metrics - Enable various metric collection features from Zephyr port
CONFIG_MEMFAULT_METRICS=y
# CONFIG_MEMFAULT_METRICS_HEARTBEAT_INTERVAL_SECS=900
CONFIG_MEMFAULT_METRICS_CPU_TEMP=n
CONFIG_MEMFAULT_METRICS_WIFI=y
CONFIG_MEMFAULT_METRICS_CONNECTIVITY_CONNECTED_TIME=y
CONFIG_MEMFAULT_METRICS_BLUETOOTH=n
CONFIG_MEMFAULT_METRICS_DEFAULT_SET_ENABLE=y
CONFIG_MEMFAULT_METRICS_SYNC_SUCCESS=y
CONFIG_MEMFAULT_METRICS_MEMFAULT_SYNC_SUCCESS=y
CONFIG_MEMFAULT_METRICS_THREADS_DEFAULTS=y
CONFIG_MEMFAULT_METRICS_BOOT_TIME=y
CONFIG_MEMFAULT_METRICS_TCP_IP=n

CONFIG_MEMFAULT_METRICS_MEMORY_USAGE=y
CONFIG_MEMFAULT_HEAP_STATS=y
CONFIG_SYS_HEAP_RUNTIME_STATS=y
CONFIG_MEMFAULT_METRICS_THREADS=y

# Certificate management
CONFIG_MEMFAULT_ROOT_CERT_STORAGE_TLS_CREDENTIAL_STORAGE=y
CONFIG_MEMFAULT_NCS_PROVISION_CERTIFICATES=y

# FOTA via Memfault configs
CONFIG_MEMFAULT_FOTA=y
# The subsystems we need so OTA payloads can be written to
# flash and updated by MCUBoot
CONFIG_DFU_TARGET=y
CONFIG_DFU_TARGET_MCUBOOT=y
CONFIG_IMG_MANAGER=y
CONFIG_FLASH=y
CONFIG_FLASH_MAP=y
CONFIG_STREAM_FLASH=y
CONFIG_IMG_ERASE_PROGRESSIVELY=y

CONFIG_FOTA_DOWNLOAD=y
CONFIG_FOTA_DOWNLOAD_PROGRESS_EVT=y

CONFIG_DOWNLOADER=y
CONFIG_DOWNLOADER_MAX_FILENAME_SIZE=400
CONFIG_DOWNLOADER_STACK_SIZE=4096

# Heap and stacks(overwritten by boards/<board>.conf)
# CONFIG_HEAP_MEM_POOL_SIZE=8192
# CONFIG_MAIN_STACK_SIZE=8192
# CONFIG_SYSTEM_WORKQUEUE_STACK_SIZE=2048
# CONFIG_NET_CONNECTION_MANAGER_MONITOR_STACK_SIZE=1024
# CONFIG_NET_MGMT_EVENT_STACK_SIZE=1024

# Memfault depends on POSIX, disable unneeded POSIX features
CONFIG_POSIX_FILE_SYSTEM=n

# SMF + zbus modular architecture
CONFIG_SMF=y
CONFIG_ZBUS=y

# General config
CONFIG_FPU=y
CONFIG_ASSERT=y
CONFIG_HW_STACK_PROTECTION=y
```

## overlay-app-https-req.conf
```kconfig
# App HTTPS Request Test overlay configuration
# Use this overlay to enable periodic HTTPS client requests

# Enable app HTTPS client functionality
CONFIG_APP_HTTPS_CLIENT_ENABLED=y

# Configure HTTPS hostname and interval
CONFIG_APP_HTTPS_HOSTNAME="example.com"
CONFIG_APP_HTTPS_REQUEST_INTERVAL_SEC=300

# App HTTPS client logging
CONFIG_APP_HTTPS_CLIENT_LOG_LEVEL_INF=y
```

## overlay-app-mqtt-echo.conf
```kconfig
# App MQTT Echo Test overlay configuration
# Use this overlay to enable MQTT client with TLS encryption and echo test
# (publishes messages and subscribes to the same topic to receive them back)

# Enable app MQTT client feature
CONFIG_APP_MQTT_CLIENT_ENABLED=y
CONFIG_APP_MQTT_CLIENT_BROKER_HOSTNAME="test.mosquitto.org"
CONFIG_APP_MQTT_CLIENT_PUBLISH_TOPIC="Count"
CONFIG_APP_MQTT_CLIENT_PUBLISH_INTERVAL_SEC=300

# App MQTT client logging
CONFIG_APP_MQTT_CLIENT_LOG_LEVEL_INF=y

# MQTT Helper library
CONFIG_MQTT_HELPER=y
CONFIG_MQTT_CLEAN_SESSION=y

# TLS for MQTT
CONFIG_MQTT_LIB_TLS=y
CONFIG_MQTT_HELPER_PORT=8883
# Keepalive reduced to 15s for networks with aggressive NAT timeouts
# Some routers drop idle TCP connections after 20-30 seconds
CONFIG_MQTT_KEEPALIVE=15

# Certificate provisioning - mqtt_helper will auto-provision from cert folder
CONFIG_MQTT_HELPER_SEC_TAG=955
CONFIG_MQTT_HELPER_PROVISION_CERTIFICATES=y
CONFIG_MQTT_HELPER_CERTIFICATES_FOLDER="src/modules/app_mqtt_client/cert"
```

## overlay-ble-prov.conf
```kconfig
#
# Copyright (c) 2025 Nordic Semiconductor ASA
#
# SPDX-License-Identifier: LicenseRef-Nordic-5-Clause
#
# BLE Provisioning overlay configuration for memfault-nrf7002dk
# Use with: west build -- -DOVERLAY_CONFIG=overlay-ble-prov.conf
#

# Enable BLE Provisioning
CONFIG_BT_WIFI_PROV=y
CONFIG_WIFI_PROV_CORE=y
CONFIG_BT_WIFI_PROV_LOG_LEVEL_INF=y

# BLE Core Configuration
CONFIG_BT=y
CONFIG_BT_SMP=y
CONFIG_BT_PERIPHERAL=y

# BLE Buffer Configuration
CONFIG_BT_BUF_ACL_RX_SIZE=151
CONFIG_BT_L2CAP_TX_MTU=147
CONFIG_BT_BUF_ACL_TX_SIZE=151

# Increased BT RX stack size because BLE and Wi-Fi operations
# run in the same BT RX workqueue thread during provisioning.
CONFIG_BT_RX_STACK_SIZE=22000
CONFIG_BT_BONDABLE=n
CONFIG_BT_DEVICE_NAME_DYNAMIC=y

# Setting BT supervision timeout to 75 units (750ms) to avoid timeout of BT connection
# when radio is granted to Wi-Fi during scan.
CONFIG_BT_PERIPHERAL_PREF_TIMEOUT=75

# Protocol Buffers support (required for BLE provisioning)
CONFIG_NANOPB=y

# Reduce heap size to fit in flash - BLE provisioning uses less heap than original sample
CONFIG_HEAP_MEM_POOL_SIZE=40144

# Network Management Event Queue
CONFIG_NET_MGMT_EVENT_QUEUE_TIMEOUT=5000

# Disable shell to save flash when BLE provisioning is enabled
CONFIG_SHELL=n
CONFIG_MEMFAULT_SHELL=n
CONFIG_NET_L2_WIFI_SHELL=n
CONFIG_NET_SHELL=n

# Enable BLE provisioning specific feature
CONFIG_BLE_PROV_ENABLED=y
```

## overlay-https-req.conf
```kconfig
# HTTPS Client overlay configuration
# Use this overlay to enable periodic HTTPS client requests

# Enable HTTPS client functionality
CONFIG_HTTPS_CLIENT_ENABLED=y

# Configure HTTPS hostname and interval
CONFIG_HTTPS_HOSTNAME="example.com"
CONFIG_HTTPS_REQUEST_INTERVAL_SEC=300

# HTTPS client logging
CONFIG_HTTPS_CLIENT_LOG_LEVEL_INF=y
```

## overlay-mqtt-echo.conf
```kconfig
# MQTT Echo Test overlay configuration
# Use this overlay to enable MQTT client with TLS encryption and echo test
# (publishes messages and subscribes to the same topic to receive them back)

# Enable MQTT client feature
CONFIG_MQTT_CLIENT_ENABLED=y
CONFIG_MQTT_CLIENT_BROKER_HOSTNAME="test.mosquitto.org"
CONFIG_MQTT_CLIENT_PUBLISH_TOPIC="Count"
CONFIG_MQTT_CLIENT_PUBLISH_INTERVAL_SEC=300

# MQTT client logging
CONFIG_MQTT_CLIENT_LOG_LEVEL_INF=y

# MQTT Helper library
CONFIG_MQTT_HELPER=y
CONFIG_MQTT_CLEAN_SESSION=y

# TLS for MQTT
CONFIG_MQTT_LIB_TLS=y
CONFIG_MQTT_HELPER_PORT=8883
# Keepalive reduced to 15s for networks with aggressive NAT timeouts
# Some routers drop idle TCP connections after 20-30 seconds
CONFIG_MQTT_KEEPALIVE=15

# Certificate provisioning - mqtt_helper will auto-provision from cert folder
CONFIG_MQTT_HELPER_SEC_TAG=955
CONFIG_MQTT_HELPER_PROVISION_CERTIFICATES=y
CONFIG_MQTT_HELPER_CERTIFICATES_FOLDER="cert"
```

## overlay-mqtt-loop.conf
```kconfig
# MQTT Client loopback overlay configuration
# Use this overlay to enable MQTT client with TLS encryption and message loopback
# (publishes messages and subscribes to the same topic to receive them back)

# Enable MQTT client feature
CONFIG_MQTT_CLIENT_ENABLED=y
CONFIG_MQTT_CLIENT_BROKER_HOSTNAME="test.mosquitto.org"
CONFIG_MQTT_CLIENT_PUBLISH_TOPIC="Count"
CONFIG_MQTT_CLIENT_PUBLISH_INTERVAL_SEC=300

# MQTT client logging
CONFIG_MQTT_CLIENT_LOG_LEVEL_INF=y

# MQTT Helper library
CONFIG_MQTT_HELPER=y
CONFIG_MQTT_CLEAN_SESSION=y

# TLS for MQTT
CONFIG_MQTT_LIB_TLS=y
CONFIG_MQTT_HELPER_PORT=8883
# Keepalive reduced to 15s for networks with aggressive NAT timeouts
# Some routers drop idle TCP connections after 20-30 seconds
CONFIG_MQTT_KEEPALIVE=15

# Certificate provisioning - mqtt_helper will auto-provision from cert folder
CONFIG_MQTT_HELPER_SEC_TAG=955
CONFIG_MQTT_HELPER_PROVISION_CERTIFICATES=y
CONFIG_MQTT_HELPER_CERTIFICATES_FOLDER="cert"
```

## boards/nrf7002dk_nrf5340_cpuapp.overlay
```dts
/*
 * Copyright (c) 2023 Nordic Semiconductor ASA
 *
 * SPDX-License-Identifier: LicenseRef-Nordic-5-Clause
 */

/ {
	/* Configure the partition manager to use the mx25r64 external flash memory. */
	chosen {
		/delete-property/ zephyr,ipc_shm;
		nordic,pm-ext-flash = &mx25r64;
	};
};

&mx25r64 {
	status = "okay";
};
```

## src/main.c
```c
/*
 * Copyright (c) 2021 Nordic Semiconductor ASA
 *
 * SPDX-License-Identifier: LicenseRef-Nordic-5-Clause
 *
 * Application entry point. All feature logic runs in modules (button, wifi,
 * memfault, ble_prov, https_client, mqtt_client) via SYS_INIT and zbus.
 */

#include <zephyr/kernel.h>
#include <zephyr/logging/log.h>
#include <zephyr/net/net_if.h>

LOG_MODULE_REGISTER(memfault_sample, CONFIG_MEMFAULT_SAMPLE_LOG_LEVEL);

int main(void)
{
	struct net_if *iface = net_if_get_default();
	struct net_linkaddr *mac_addr = iface ? net_if_get_link_addr(iface) : NULL;

	LOG_INF("==============================================");
	LOG_INF("Memfault nRF7002DK");
	LOG_INF("==============================================");
	LOG_INF("Version: %s", CONFIG_MEMFAULT_NCS_FW_VERSION);
	LOG_INF("Build: %s %s", __DATE__, __TIME__);
	LOG_INF("Board: %s", CONFIG_BOARD);
	if (mac_addr && mac_addr->len == 6) {
		LOG_INF("MAC: %02X:%02X:%02X:%02X:%02X:%02X",
			mac_addr->addr[0], mac_addr->addr[1], mac_addr->addr[2],
			mac_addr->addr[3], mac_addr->addr[4], mac_addr->addr[5]);
	}
	LOG_INF("==============================================");
	LOG_INF("All modules run via SYS_INIT and zbus");
	LOG_INF("==============================================");

	for (;;) {
		k_sleep(K_FOREVER);
	}
	return 0;
}
```

## src/ble_provisioning.c
```c
/*
 * Copyright (c) 2025 Nordic Semiconductor ASA
 *
 * SPDX-License-Identifier: LicenseRef-Nordic-5-Clause
 */

#include "ble_provisioning.h"
#include <zephyr/types.h>
#include <stddef.h>
#include <string.h>
#include <errno.h>
#include <zephyr/sys/printk.h>
#include <zephyr/kernel.h>
#include <zephyr/bluetooth/bluetooth.h>
#include <zephyr/bluetooth/hci.h>
#include <zephyr/bluetooth/conn.h>
#include <zephyr/bluetooth/uuid.h>
#include <zephyr/bluetooth/gatt.h>

#include <zephyr/net/wifi.h>
#include <zephyr/net/wifi_mgmt.h>
#include <zephyr/net/wifi_credentials.h>
#include <zephyr/net/net_mgmt.h>
#include <zephyr/net/net_if.h>

#include <net/wifi_prov_core/wifi_prov_core.h>
#include <bluetooth/services/wifi_provisioning.h>

#include <zephyr/logging/log.h>
LOG_MODULE_REGISTER(ble_prov, CONFIG_MEMFAULT_SAMPLE_LOG_LEVEL);

#define WIFI_RECONNECT_DELAY_SEC 5

#ifdef CONFIG_WIFI_PROV_ADV_DATA_UPDATE
#define ADV_DATA_UPDATE_INTERVAL CONFIG_WIFI_PROV_ADV_DATA_UPDATE_INTERVAL
#endif /* CONFIG_WIFI_PROV_ADV_DATA_UPDATE */

#define ADV_PARAM_UPDATE_DELAY 1

#define ADV_DATA_VERSION_IDX          (BT_UUID_SIZE_128 + 0)
#define ADV_DATA_FLAG_IDX             (BT_UUID_SIZE_128 + 1)
#define ADV_DATA_FLAG_PROV_STATUS_BIT BIT(0)
#define ADV_DATA_FLAG_CONN_STATUS_BIT BIT(1)
#define ADV_DATA_RSSI_IDX             (BT_UUID_SIZE_128 + 3)

#define PROV_BT_LE_ADV_PARAM_FAST                                                                  \
	BT_LE_ADV_PARAM(BT_LE_ADV_OPT_CONN, BT_GAP_ADV_FAST_INT_MIN_2, BT_GAP_ADV_FAST_INT_MAX_2,  \
			NULL)

#define PROV_BT_LE_ADV_PARAM_SLOW                                                                  \
	BT_LE_ADV_PARAM(BT_LE_ADV_OPT_CONN, BT_GAP_ADV_SLOW_INT_MIN, BT_GAP_ADV_SLOW_INT_MAX, NULL)

#define ADV_DAEMON_STACK_SIZE 4096
#define ADV_DAEMON_PRIORITY   5

/* Work item for triggering WiFi connection after provisioning */
static struct k_work_delayable wifi_connect_work;
static bool wifi_connect_requested = false;

/* Track BLE connection state to avoid updating advertising while connected */
static struct bt_conn *current_conn = NULL;

static bool wifi_reconnect_pending = false;

static struct net_mgmt_event_callback wifi_mgmt_cb;

/* Flag to track if we've already requested connection after provisioning */
static bool connection_requested_after_provisioning = false;

/* Flag to indicate if credentials existed at boot time */
static bool credentials_existed_at_boot = false;

/* Track the last known provisioning state to detect new provisioning */
static bool last_prov_state = false;

K_THREAD_STACK_DEFINE(adv_daemon_stack_area, ADV_DAEMON_STACK_SIZE);

static struct k_work_q adv_daemon_work_q;

static uint8_t device_name[] = {'P', 'V', '0', '0', '0', '0', '0', '0'};

static uint8_t prov_svc_data[] = {BT_UUID_PROV_VAL, 0x00, 0x00, 0x00, 0x00};

static const struct bt_data ad[] = {
	BT_DATA_BYTES(BT_DATA_FLAGS, (BT_LE_AD_GENERAL | BT_LE_AD_NO_BREDR)),
	BT_DATA_BYTES(BT_DATA_UUID128_ALL, BT_UUID_PROV_VAL),
	BT_DATA(BT_DATA_NAME_COMPLETE, device_name, sizeof(device_name)),
};

static const struct bt_data sd[] = {
	BT_DATA(BT_DATA_SVC_DATA128, prov_svc_data, sizeof(prov_svc_data)),
};

static struct k_work_delayable update_adv_param_work;
static struct k_work_delayable update_adv_data_work;

static void wifi_mgmt_event_handler(struct net_mgmt_event_callback *cb, uint64_t mgmt_event,
				    struct net_if *iface)
{
	ARG_UNUSED(iface);

	if (!wifi_prov_state_get()) {
		return;
	}

	switch (mgmt_event) {
	case NET_EVENT_WIFI_DISCONNECT_RESULT:
		/* Skip reconnect if BLE client is connected (provisioning in progress) */
		if (current_conn != NULL) {
			LOG_INF("BLE client connected, skipping WiFi auto-reconnect");
			break;
		}
		/* Schedule reconnect only if not already pending */
		if (!wifi_reconnect_pending) {
			wifi_reconnect_pending = true;
			k_work_reschedule(&wifi_connect_work, K_SECONDS(WIFI_RECONNECT_DELAY_SEC));
			LOG_INF("WiFi disconnected, scheduling reconnect");
		}
		break;
	case NET_EVENT_WIFI_CONNECT_RESULT:
		/* Reset reconnect flag on connection result */
		wifi_reconnect_pending = false;
		break;
	default:
		break;
	}
}

static void wifi_connect_work_handler(struct k_work *work)
{
	int err;
	struct net_if *iface = net_if_get_default();

	/* Skip reconnect if BLE client is connected (provisioning in progress) */
	if (current_conn != NULL) {
		LOG_INF("BLE client connected, skipping WiFi reconnect attempt");
		wifi_reconnect_pending = false;
		return;
	}

	/* Check if credentials are now available (they were just provisioned) */
	if (!wifi_credentials_is_empty()) {
		LOG_INF("WiFi credentials detected, attempting to connect");
		err = net_mgmt(NET_REQUEST_WIFI_CONNECT_STORED, iface, NULL, 0);
		if (err) {
			LOG_ERR("WiFi connection request failed: %d", err);
			/* Reset flag to allow retry */
			wifi_connect_requested = false;
			wifi_reconnect_pending = false;
			connection_requested_after_provisioning = false;
		} else {
			LOG_INF("WiFi connection request sent successfully");
			wifi_reconnect_pending = false;
		}
	}
}

static void update_wifi_status_in_adv(void)
{
	int rc;
	struct net_if *iface = net_if_get_default();
	struct wifi_iface_status status = {0};
	bool current_prov_state;

	prov_svc_data[ADV_DATA_VERSION_IDX] = PROV_SVC_VER;

	current_prov_state = wifi_prov_state_get();

	/* Detect new provisioning: state changed from unprovisioned to provisioned */
	if (current_prov_state && !last_prov_state) {
		LOG_INF("New WiFi provisioning detected");
		/* Reset flags to allow new connection attempt */
		connection_requested_after_provisioning = false;
		credentials_existed_at_boot = false;
	}
	last_prov_state = current_prov_state;

	/* If no config, mark it as unprovisioned. */
	if (!current_prov_state) {
		prov_svc_data[ADV_DATA_FLAG_IDX] &= ~ADV_DATA_FLAG_PROV_STATUS_BIT;
	} else {
		prov_svc_data[ADV_DATA_FLAG_IDX] |= ADV_DATA_FLAG_PROV_STATUS_BIT;

		/* Only trigger connection if:
		 * 1. We haven't already requested connection
		 * 2. Credentials exist
		 * 3. Credentials did NOT exist at boot (meaning they were just added via BLE)
		 * 4. WiFi is not already connected
		 */
		if (!connection_requested_after_provisioning && !wifi_credentials_is_empty() &&
		    !credentials_existed_at_boot) {
			rc = net_mgmt(NET_REQUEST_WIFI_IFACE_STATUS, iface, &status,
				      sizeof(status));
			bool wifi_is_connected = (rc == 0 && status.state >= WIFI_STATE_ASSOCIATED);

			if (!wifi_is_connected) {
				connection_requested_after_provisioning = true;
				k_work_reschedule(&wifi_connect_work, K_SECONDS(2));
				LOG_INF("WiFi credentials provisioned, scheduling connection "
					"attempt");
			}
		}
	}

	rc = net_mgmt(NET_REQUEST_WIFI_IFACE_STATUS, iface, &status,
		      sizeof(struct wifi_iface_status));
	/* If WiFi is not connected or error occurs, mark it as not connected. */
	if ((rc != 0) || (status.state < WIFI_STATE_ASSOCIATED)) {
		prov_svc_data[ADV_DATA_FLAG_IDX] &= ~ADV_DATA_FLAG_CONN_STATUS_BIT;
		prov_svc_data[ADV_DATA_RSSI_IDX] = INT8_MIN;
	} else {
		/* WiFi is connected. */
		prov_svc_data[ADV_DATA_FLAG_IDX] |= ADV_DATA_FLAG_CONN_STATUS_BIT;
		prov_svc_data[ADV_DATA_RSSI_IDX] = status.rssi;
	}
}

static void connected(struct bt_conn *conn, uint8_t err)
{
	char addr[BT_ADDR_LE_STR_LEN];

	if (err) {
		LOG_ERR("BT Connection failed (err 0x%02x)", err);
		return;
	}

	bt_addr_le_to_str(bt_conn_get_dst(conn), addr, sizeof(addr));
	LOG_INF("BT Connected: %s", addr);

	/* Store connection reference and stop advertising updates */
	current_conn = bt_conn_ref(conn);
	k_work_cancel_delayable(&update_adv_data_work);
}

static void disconnected(struct bt_conn *conn, uint8_t reason)
{
	char addr[BT_ADDR_LE_STR_LEN];

	bt_addr_le_to_str(bt_conn_get_dst(conn), addr, sizeof(addr));
	LOG_INF("BT Disconnected: %s (reason 0x%02x)", addr, reason);

	/* Release connection reference */
	if (current_conn) {
		bt_conn_unref(current_conn);
		current_conn = NULL;
	}

	k_work_reschedule_for_queue(&adv_daemon_work_q, &update_adv_param_work,
				    K_SECONDS(ADV_PARAM_UPDATE_DELAY));
	/* Delay ad data update until after advertising restarts to avoid EAGAIN (-11) */
	k_work_reschedule_for_queue(&adv_daemon_work_q, &update_adv_data_work,
				    K_SECONDS(ADV_PARAM_UPDATE_DELAY + 1));
}

static void identity_resolved(struct bt_conn *conn, const bt_addr_le_t *rpa,
			      const bt_addr_le_t *identity)
{
	char addr_identity[BT_ADDR_LE_STR_LEN];
	char addr_rpa[BT_ADDR_LE_STR_LEN];

	bt_addr_le_to_str(identity, addr_identity, sizeof(addr_identity));
	bt_addr_le_to_str(rpa, addr_rpa, sizeof(addr_rpa));

	LOG_INF("BT Identity resolved %s -> %s", addr_rpa, addr_identity);
}

static void security_changed(struct bt_conn *conn, bt_security_t level, enum bt_security_err err)
{
	char addr[BT_ADDR_LE_STR_LEN];

	bt_addr_le_to_str(bt_conn_get_dst(conn), addr, sizeof(addr));

	if (!err) {
		LOG_INF("BT Security changed: %s level %u", addr, level);
	} else {
		LOG_ERR("BT Security failed: %s level %u err %d", addr, level, err);
	}
}

BT_CONN_CB_DEFINE(conn_callbacks) = {
	.connected = connected,
	.disconnected = disconnected,
	.identity_resolved = identity_resolved,
	.security_changed = security_changed,
};

static void auth_cancel(struct bt_conn *conn)
{
	char addr[BT_ADDR_LE_STR_LEN];

	bt_addr_le_to_str(bt_conn_get_dst(conn), addr, sizeof(addr));

	LOG_WRN("BT Pairing cancelled: %s", addr);
}

static struct bt_conn_auth_cb auth_cb_display = {
	.cancel = auth_cancel,
};

static void pairing_complete(struct bt_conn *conn, bool bonded)
{
	char addr[BT_ADDR_LE_STR_LEN];

	bt_addr_le_to_str(bt_conn_get_dst(conn), addr, sizeof(addr));
	LOG_INF("BT pairing completed: %s, bonded: %d", addr, bonded);
}

static void pairing_failed(struct bt_conn *conn, enum bt_security_err reason)
{
	LOG_ERR("BT Pairing Failed (%d). Disconnecting.", reason);
	bt_conn_disconnect(conn, BT_HCI_ERR_AUTH_FAIL);
}

static struct bt_conn_auth_info_cb auth_info_cb_display = {
	.pairing_complete = pairing_complete,
	.pairing_failed = pairing_failed,
};

static void update_adv_data_task(struct k_work *item)
{
	int rc;

	/* Always update WiFi status logic (triggers connection if needed) */
	update_wifi_status_in_adv();

	/* Skip advertisement data updates if we have an active BLE connection
	 * to avoid bt_le_adv_update_data() error -11
	 */
	if (current_conn != NULL) {
		LOG_DBG("Skipping advertisement data update - BLE client connected");
#ifdef CONFIG_WIFI_PROV_ADV_DATA_UPDATE
		k_work_reschedule_for_queue(&adv_daemon_work_q, &update_adv_data_work,
					    K_SECONDS(ADV_DATA_UPDATE_INTERVAL));
#endif
		return;
	}

	rc = bt_le_adv_update_data(ad, ARRAY_SIZE(ad), sd, ARRAY_SIZE(sd));
	if (rc != 0 && rc != -EAGAIN) {
		LOG_ERR("Cannot update advertisement data, err = %d", rc);
	} else if (rc == -EAGAIN) {
		LOG_DBG("Advertisement update deferred, advertising not active");
	}
#ifdef CONFIG_WIFI_PROV_ADV_DATA_UPDATE
	k_work_reschedule_for_queue(&adv_daemon_work_q, &update_adv_data_work,
				    K_SECONDS(ADV_DATA_UPDATE_INTERVAL));
#endif /* CONFIG_WIFI_PROV_ADV_DATA_UPDATE */
}

static void update_adv_param_task(struct k_work *item)
{
	int rc;

	rc = bt_le_adv_stop();
	if (rc != 0) {
		LOG_ERR("Cannot stop advertisement: err = %d", rc);
		return;
	}

	rc = bt_le_adv_start(prov_svc_data[ADV_DATA_FLAG_IDX] & ADV_DATA_FLAG_PROV_STATUS_BIT
				     ? PROV_BT_LE_ADV_PARAM_SLOW
				     : PROV_BT_LE_ADV_PARAM_FAST,
			     ad, ARRAY_SIZE(ad), sd, ARRAY_SIZE(sd));
	if (rc != 0) {
		LOG_ERR("Cannot start advertisement: err = %d", rc);
	}
}

static void byte_to_hex(char *ptr, uint8_t byte, char base)
{
	int i, val;

	for (i = 0, val = (byte & 0xf0) >> 4; i < 2; i++, val = byte & 0x0f) {
		if (val < 10) {
			*ptr++ = (char)(val + '0');
		} else {
			*ptr++ = (char)(val - 10 + base);
		}
	}
}

static void update_dev_name(struct net_linkaddr *mac_addr)
{
	byte_to_hex(&device_name[2], mac_addr->addr[3], 'A');
	byte_to_hex(&device_name[4], mac_addr->addr[4], 'A');
	byte_to_hex(&device_name[6], mac_addr->addr[5], 'A');
}

int ble_prov_init(void)
{
	int rc;
	struct net_if *iface = net_if_get_default();
	struct net_linkaddr *mac_addr = net_if_get_link_addr(iface);
	char device_name_str[sizeof(device_name) + 1];

	/* Check if credentials already exist at boot time */
	credentials_existed_at_boot = !wifi_credentials_is_empty();
	last_prov_state = wifi_prov_state_get();

	if (credentials_existed_at_boot) {
		/* Mark connection as already requested since main.c handles it */
		connection_requested_after_provisioning = true;
		LOG_INF("WiFi credentials exist at boot, skipping BLE auto-connect");
	}

	bt_conn_auth_cb_register(&auth_cb_display);
	bt_conn_auth_info_cb_register(&auth_info_cb_display);

	rc = bt_enable(NULL);
	if (rc) {
		LOG_ERR("Bluetooth init failed (err %d)", rc);
		return rc;
	}

	LOG_INF("Bluetooth initialized");

	rc = wifi_prov_init();
	if (rc == 0) {
		LOG_INF("Wi-Fi provisioning service starts successfully");
	} else {
		LOG_ERR("Error initializing Wi-Fi provisioning service");
		return rc;
	}

	/* Prepare advertisement data */
	if (mac_addr) {
		update_dev_name(mac_addr);
	}
	device_name_str[sizeof(device_name_str) - 1] = '\0';
	memcpy(device_name_str, device_name, sizeof(device_name));
	bt_set_name(device_name_str);

	rc = bt_le_adv_start(prov_svc_data[ADV_DATA_FLAG_IDX] & ADV_DATA_FLAG_PROV_STATUS_BIT
				     ? PROV_BT_LE_ADV_PARAM_SLOW
				     : PROV_BT_LE_ADV_PARAM_FAST,
			     ad, ARRAY_SIZE(ad), sd, ARRAY_SIZE(sd));
	if (rc) {
		LOG_ERR("BT Advertising failed to start (err %d)", rc);
		return rc;
	}
	LOG_INF("BT Advertising successfully started");

	update_wifi_status_in_adv();

	/* Register WiFi management event handler for reconnect logic */
	net_mgmt_init_event_callback(&wifi_mgmt_cb, wifi_mgmt_event_handler,
				     NET_EVENT_WIFI_DISCONNECT_RESULT |
					     NET_EVENT_WIFI_CONNECT_RESULT);
	net_mgmt_add_event_callback(&wifi_mgmt_cb);

	k_work_queue_init(&adv_daemon_work_q);
	k_work_queue_start(&adv_daemon_work_q, adv_daemon_stack_area,
			   K_THREAD_STACK_SIZEOF(adv_daemon_stack_area), ADV_DAEMON_PRIORITY, NULL);

	k_work_init_delayable(&wifi_connect_work, wifi_connect_work_handler);
	k_work_init_delayable(&update_adv_param_work, update_adv_param_task);
	k_work_init_delayable(&update_adv_data_work, update_adv_data_task);
#ifdef CONFIG_WIFI_PROV_ADV_DATA_UPDATE
	k_work_schedule_for_queue(&adv_daemon_work_q, &update_adv_data_work,
				  K_SECONDS(ADV_DATA_UPDATE_INTERVAL));
#endif /* CONFIG_WIFI_PROV_ADV_DATA_UPDATE */

	return 0;
}

void ble_prov_update_wifi_status(bool connected)
{
	/* Reset connection request flag when WiFi connects */
	if (connected) {
		wifi_connect_requested = false;
		wifi_reconnect_pending = false;
	}

	/* Update advertisement data with current WiFi status */
	k_work_reschedule_for_queue(&adv_daemon_work_q, &update_adv_data_work, K_NO_WAIT);
}
```

## src/ble_provisioning.h
```c
/*
 * Copyright (c) 2025 Nordic Semiconductor ASA
 *
 * SPDX-License-Identifier: LicenseRef-Nordic-5-Clause
 */

#ifndef BLE_PROVISIONING_H_
#define BLE_PROVISIONING_H_

#include <zephyr/kernel.h>

/**
 * @brief Initialize BLE provisioning
 *
 * This function sets up Bluetooth LE and starts advertising for Wi-Fi provisioning.
 * It should be called early in the application lifecycle.
 *
 * @return 0 on success, negative error code on failure
 */
int ble_prov_init(void);

/**
 * @brief Update WiFi connection status in BLE advertisement
 *
 * This function should be called when WiFi connection status changes
 * to reflect the current state in BLE advertisements.
 *
 * @param connected true if WiFi is connected, false otherwise
 */
void ble_prov_update_wifi_status(bool connected);

#endif /* BLE_PROVISIONING_H_ */
```

## src/https_client.c
```c
/*
 * Copyright (c) 2026 Nordic Semiconductor ASA
 *
 * SPDX-License-Identifier: LicenseRef-Nordic-5-Clause
 */

#include "https_client.h"

#include <string.h>
#include <zephyr/kernel.h>
#include <stdlib.h>
#include <zephyr/net/socket.h>
#include <zephyr/net/tls_credentials.h>
#include <zephyr/logging/log.h>
#include <memfault/metrics/metrics.h>

#if defined(CONFIG_POSIX_API)
#include <zephyr/posix/arpa/inet.h>
#include <zephyr/posix/netdb.h>
#include <zephyr/posix/unistd.h>
#include <zephyr/posix/sys/socket.h>
#endif

#if CONFIG_MODEM_KEY_MGMT
#include <modem/modem_key_mgmt.h>
#endif

LOG_MODULE_REGISTER(https_client_app, CONFIG_HTTPS_CLIENT_LOG_LEVEL);

#define HTTPS_PORT "443"
#define HTTP_HEAD                                                                                  \
	"HEAD / HTTP/1.1\r\n"                                                                      \
	"Host: " CONFIG_HTTPS_HOSTNAME ":" HTTPS_PORT "\r\n"                                       \
	"Connection: close\r\n\r\n"

#define HTTP_HEAD_LEN (sizeof(HTTP_HEAD) - 1)
#define HTTP_HDR_END  "\r\n\r\n"

#define RECV_BUF_SIZE 2048
#define TLS_SEC_TAG   42

#define HTTPS_REQUEST_INTERVAL_SEC CONFIG_HTTPS_REQUEST_INTERVAL_SEC

static const char send_buf[] = HTTP_HEAD;
static char recv_buf[RECV_BUF_SIZE];
static K_SEM_DEFINE(https_thread_sem, 0, 1);
static bool https_client_running = false;
static bool network_ready = false;
static uint32_t https_req_total;    /* Local counter for total requests */
static uint32_t https_req_failures; /* Local counter for failed requests */

/* Certificate for hostname */
static const char cert[] = {
#include "SSLcom-TLS-Root-2022-ECC.pem.inc"

	/* Null terminate certificate if running Mbed TLS on the application core.
	 * Required by TLS credentials API.
	 */
	IF_ENABLED(CONFIG_TLS_CREDENTIALS, (0x00)) };

BUILD_ASSERT(sizeof(cert) < KB(4), "Certificate too large");

/* Provision certificate to modem */
static int cert_provision(void)
{
	int err;

	LOG_INF("Provisioning certificate");

#if CONFIG_MODEM_KEY_MGMT
	bool exists;
	int mismatch;

	/* It may be sufficient for you application to check whether the correct
	 * certificate is provisioned with a given tag directly using modem_key_mgmt_cmp().
	 * Here, for the sake of the completeness, we check that a certificate exists
	 * before comparing it with what we expect it to be.
	 */
	err = modem_key_mgmt_exists(TLS_SEC_TAG, MODEM_KEY_MGMT_CRED_TYPE_CA_CHAIN, &exists);
	if (err) {
		LOG_ERR("Failed to check for certificates err %d", err);
		return err;
	}

	if (exists) {
		mismatch = modem_key_mgmt_cmp(TLS_SEC_TAG, MODEM_KEY_MGMT_CRED_TYPE_CA_CHAIN, cert,
					      sizeof(cert));
		if (!mismatch) {
			LOG_INF("Certificate match");
			return 0;
		}

		LOG_INF("Certificate mismatch");
		err = modem_key_mgmt_delete(TLS_SEC_TAG, MODEM_KEY_MGMT_CRED_TYPE_CA_CHAIN);
		if (err) {
			LOG_ERR("Failed to delete existing certificate, err %d", err);
		}
	}

	LOG_INF("Provisioning certificate to the modem");

	/*  Provision certificate to the modem */
	err = modem_key_mgmt_write(TLS_SEC_TAG, MODEM_KEY_MGMT_CRED_TYPE_CA_CHAIN, cert,
				   sizeof(cert));
	if (err) {
		LOG_ERR("Failed to provision certificate, err %d", err);
		return err;
	}
#else  /* CONFIG_MODEM_KEY_MGMT */
	err = tls_credential_add(TLS_SEC_TAG, TLS_CREDENTIAL_CA_CERTIFICATE, cert, sizeof(cert));
	if (err == -EEXIST) {
		LOG_INF("CA certificate already exists, sec tag: %d", TLS_SEC_TAG);
	} else if (err < 0) {
		LOG_ERR("Failed to register CA certificate: %d", err);
		return err;
	}
#endif /* !CONFIG_MODEM_KEY_MGMT */

	return 0;
}

/* Setup TLS options on a given socket */
static int tls_setup(int fd)
{
	int err;
	int verify;

	/* Security tag that we have provisioned the certificate with */
	const sec_tag_t tls_sec_tag[] = {
		TLS_SEC_TAG,
	};

	/* Set up TLS peer verification */
	enum {
		NONE = 0,
		OPTIONAL = 1,
		REQUIRED = 2,
	};

	verify = REQUIRED;

	err = setsockopt(fd, SOL_TLS, TLS_PEER_VERIFY, &verify, sizeof(verify));
	if (err) {
		LOG_ERR("Failed to setup peer verification, err %d", errno);
		return err;
	}

	/* Associate the socket with the security tag
	 * we have provisioned the certificate with.
	 */
	err = setsockopt(fd, SOL_TLS, TLS_SEC_TAG_LIST, tls_sec_tag, sizeof(tls_sec_tag));
	if (err) {
		LOG_ERR("Failed to setup TLS sec tag, err %d", errno);
		return err;
	}

	err = setsockopt(fd, SOL_TLS, TLS_HOSTNAME, CONFIG_HTTPS_HOSTNAME,
			 sizeof(CONFIG_HTTPS_HOSTNAME) - 1);
	if (err) {
		LOG_ERR("Failed to setup TLS hostname, err %d", errno);
		return err;
	}
	return 0;
}

static void send_http_request(void)
{
	int err;
	int fd = -1;
	char *p;
	int bytes;
	size_t off;
	struct addrinfo *res = NULL;
	struct addrinfo hints = {
		.ai_flags = AI_NUMERICSERV, /* Let getaddrinfo() set port */
		.ai_socktype = SOCK_STREAM,
		.ai_family = AF_INET, /* Force IPv4 to reduce DNS lookup time */
	};
	char peer_addr[INET6_ADDRSTRLEN];
	bool request_failed = false;

	if (!network_ready) {
		LOG_WRN("Network not ready, skipping HTTPS request");
		return;
	}

	/* Increment total request count (both local and Memfault) */
	https_req_total++;
	MEMFAULT_METRIC_SET_UNSIGNED(https_req_total_count, https_req_total);

	LOG_INF("Looking up %s", CONFIG_HTTPS_HOSTNAME);

	err = getaddrinfo(CONFIG_HTTPS_HOSTNAME, HTTPS_PORT, &hints, &res);
	if (err) {
		LOG_ERR("getaddrinfo() failed, err %d", errno);
		request_failed = true;
		goto clean_up;
	}

	inet_ntop(res->ai_family, &((struct sockaddr_in *)(res->ai_addr))->sin_addr, peer_addr,
		  INET6_ADDRSTRLEN);
	LOG_INF("Resolved %s (%s)", peer_addr, net_family2str(res->ai_family));

	if (IS_ENABLED(CONFIG_SAMPLE_TFM_MBEDTLS)) {
		fd = socket(res->ai_family, SOCK_STREAM | SOCK_NATIVE_TLS, IPPROTO_TLS_1_2);
	} else {
		fd = socket(res->ai_family, SOCK_STREAM, IPPROTO_TLS_1_2);
	}
	if (fd == -1) {
		LOG_ERR("socket() failed, err %d", errno);
		request_failed = true;
		goto clean_up;
	}

	/* Set socket timeouts to prevent hanging */
	struct timeval timeout = {
		.tv_sec = 30,
		.tv_usec = 0,
	};
	(void)setsockopt(fd, SOL_SOCKET, SO_RCVTIMEO, &timeout, sizeof(timeout));
	(void)setsockopt(fd, SOL_SOCKET, SO_SNDTIMEO, &timeout, sizeof(timeout));

	/* Setup TLS socket options */
	err = tls_setup(fd);
	if (err) {
		LOG_ERR("TLS setup failed");
		request_failed = true;
		goto clean_up;
	}

	LOG_INF("Connecting to %s:%d", CONFIG_HTTPS_HOSTNAME,
		ntohs(((struct sockaddr_in *)(res->ai_addr))->sin_port));
	err = connect(fd, res->ai_addr, res->ai_addrlen);
	if (err) {
		LOG_ERR("connect() failed, err: %d", errno);
		request_failed = true;
		goto clean_up;
	}

	off = 0;
	do {
		bytes = send(fd, &send_buf[off], HTTP_HEAD_LEN - off, 0);
		if (bytes < 0) {
			LOG_ERR("send() failed, err %d", errno);
			request_failed = true;
			goto clean_up;
		}
		off += bytes;
	} while (off < HTTP_HEAD_LEN);

	LOG_INF("Sent %d bytes", off);

	off = 0;
	do {
		bytes = recv(fd, &recv_buf[off], RECV_BUF_SIZE - off, 0);
		if (bytes < 0) {
			LOG_ERR("recv() failed, err %d", errno);
			request_failed = true;
			goto clean_up;
		}
		off += bytes;
	} while (bytes != 0 /* peer closed connection */);

	LOG_INF("Received %d bytes", off);

	/* Make sure recv_buf is NULL terminated (for safe use with strstr) */
	if (off < sizeof(recv_buf)) {
		recv_buf[off] = '\0';
	} else {
		recv_buf[sizeof(recv_buf) - 1] = '\0';
	}

	/* Print HTTP response */
	p = strstr(recv_buf, "\r\n");
	if (p) {
		off = p - recv_buf;
		recv_buf[off + 1] = '\0';
		LOG_INF("Response: %s", recv_buf);
	}

	LOG_DBG("Finished, closing socket");

clean_up:
	if (request_failed) {
		https_req_failures++;
		MEMFAULT_METRIC_SET_UNSIGNED(https_req_fail_count, https_req_failures);
	}
	/* Log local metrics after each request */
	LOG_INF("HTTPS Request Test Metrics - Total: %u, Failures: %u", https_req_total,
		https_req_failures);

	if (fd >= 0) {
		/* Graceful shutdown - notify peer we're done sending */
		(void)zsock_shutdown(fd, ZSOCK_SHUT_RDWR);
		(void)close(fd);
		/* Small delay to allow TCP/TLS resources to be released */
		k_sleep(K_MSEC(100));
	}
	if (res) {
		freeaddrinfo(res);
	}
}

static void https_client_thread(void *arg1, void *arg2, void *arg3)
{
	ARG_UNUSED(arg1);
	ARG_UNUSED(arg2);
	ARG_UNUSED(arg3);

	uint32_t http_request_count = 1;
	int cert_provisioned = 0;

	LOG_INF("HTTPS client thread started");

	while (https_client_running) {
		/* Wait for network connection */
		k_sem_take(&https_thread_sem, K_FOREVER);

		if (!https_client_running) {
			break;
		}

		/* Provision certificates once when first connected */
		if (!cert_provisioned) {
			int err = cert_provision();
			if (err) {
				LOG_ERR("Certificate provisioning failed: %d", err);
				network_ready = false;
				continue;
			}
			cert_provisioned = 1;
			LOG_INF("Certificate provisioned successfully");
		}

		network_ready = true;
		LOG_INF("Network ready, sending HTTPS requests every %d seconds",
			HTTPS_REQUEST_INTERVAL_SEC);

		k_sleep(K_SECONDS(3));
		while (https_client_running && network_ready) {
			send_http_request();
			LOG_INF("HTTP request count: %d", http_request_count++);

			/* Sleep for the configured interval */
			k_sleep(K_SECONDS(HTTPS_REQUEST_INTERVAL_SEC));
		}

		LOG_INF("Network disconnected or client stopped");
	}

	LOG_INF("HTTPS client thread exiting");
}

K_THREAD_DEFINE(https_client_tid, CONFIG_HTTPS_CLIENT_STACK_SIZE, https_client_thread, NULL, NULL,
		NULL, CONFIG_HTTPS_CLIENT_THREAD_PRIORITY, 0, 0);

int https_client_init(void)
{
	LOG_INF("HTTPS client initialized");
	https_client_running = true;
	return 0;
}

void https_client_notify_connected(void)
{
	if (https_client_running) {
		LOG_INF("Network connected, notifying HTTPS client");
		network_ready = true;
		/* Only give semaphore if it's not already taken */
		k_sem_give(&https_thread_sem);
	}
}

void https_client_notify_disconnected(void)
{
	LOG_INF("Network disconnected, pausing HTTPS client");
	network_ready = false;
}
```

## src/https_client.h
```c
/*
 * Copyright (c) 2020 Nordic Semiconductor ASA
 *
 * SPDX-License-Identifier: LicenseRef-Nordic-5-Clause
 */

#ifndef HTTPS_CLIENT_H_
#define HTTPS_CLIENT_H_

/**
 * @brief Initialize the HTTPS client
 *
 * @return 0 on success, negative error code on failure
 */
int https_client_init(void);

/**
 * @brief Notify HTTPS client that network connection is established
 *
 * This function should be called when the device successfully connects
 * to the network. It will trigger the HTTPS client to start sending
 * periodic requests.
 */
void https_client_notify_connected(void);

/**
 * @brief Notify HTTPS client that network connection is lost
 *
 * This function should be called when the device loses network connectivity.
 * It will pause the HTTPS client from sending requests.
 */
void https_client_notify_disconnected(void);

#endif /* HTTPS_CLIENT_H_ */
```

## src/mflt_nrf70_fw_stats_cdr.c
```c
/*
 * Copyright (c) 2025 Nordic Semiconductor ASA
 *
 * SPDX-License-Identifier: LicenseRef-Nordic-5-Clause
 *
 * nRF70 Firmware Statistics CDR (Custom Data Recording) for Memfault
 *
 * This module collects nRF70 WiFi firmware statistics (PHY, LMAC, UMAC)
 * as a binary blob and uploads them to Memfault using the CDR feature.
 *
 * IMPLEMENTATION: Uses direct FMAC API (nrf_wifi_sys_fmac_stats_get) like
 * wifi_util.c does. This provides ON-DEMAND stats collection without
 * per-packet polling overhead.
 *
 * The blob can be parsed using the nrf70_fw_stats_parser.py script
 * located at: modules/lib/nrf_wifi/scripts/nrf70_fw_stats_parser.py
 */

#include <zephyr/kernel.h>
#include <zephyr/logging/log.h>
#include <string.h>

/* Direct FMAC API access - same includes as wifi_util.c */
#include "host_rpu_umac_if.h"
#include "system/fmac_api.h"
#include "fmac_main.h"

/* Stats structure definitions */
#include "rpu_lmac_phy_stats.h"
#include "rpu_umac_stats.h"

#include "memfault/components.h"
#include "memfault/core/data_packetizer.h"

/* External reference to the global nRF70 driver context (same as wifi_util.c) */
extern struct nrf_wifi_drv_priv_zep rpu_drv_priv_zep;

LOG_MODULE_REGISTER(mflt_nrf70_fw_stats_cdr, CONFIG_MEMFAULT_SAMPLE_LOG_LEVEL);

/* Maximum expected size of nRF70 FW stats blob (161 uint32_t values = 644 bytes) */
#define NRF70_FW_STATS_BLOB_MAX_SIZE 1024

/* Forward declarations for CDR callbacks */
static bool has_cdr_cb(sMemfaultCdrMetadata *metadata);
static bool read_data_cb(uint32_t offset, void *buf, size_t buf_len);
static void mark_cdr_read_cb(void);

/* MIME types for the CDR payload */
static const char *const mimetypes[] = {MEMFAULT_CDR_BINARY};

/* Buffer to hold the collected nRF70 FW stats blob */
static uint8_t s_nrf70_fw_stats_blob[NRF70_FW_STATS_BLOB_MAX_SIZE];
static size_t s_nrf70_fw_stats_blob_size = 0;
static bool s_cdr_data_ready = false;
static size_t s_read_offset = 0;

/* CDR metadata */
static sMemfaultCdrMetadata s_nrf70_fw_stats_metadata = {
	.start_time.type = kMemfaultCurrentTimeType_Unknown,
	.mimetypes = (const char **)mimetypes,
	.num_mimetypes = 1,
	.data_size_bytes = 0,
	.duration_ms = 0,
	.collection_reason = "nrf70_fw_stats",
};

/* CDR source implementation */
static const sMemfaultCdrSourceImpl s_nrf70_fw_stats_cdr_source = {
	.has_cdr_cb = has_cdr_cb,
	.read_data_cb = read_data_cb,
	.mark_cdr_read_cb = mark_cdr_read_cb,
};

/**
 * @brief Check if CDR data is available
 */
static bool has_cdr_cb(sMemfaultCdrMetadata *metadata)
{
	if (!s_cdr_data_ready || s_nrf70_fw_stats_blob_size == 0) {
		return false;
	}

	s_nrf70_fw_stats_metadata.data_size_bytes = s_nrf70_fw_stats_blob_size;
	*metadata = s_nrf70_fw_stats_metadata;

	LOG_DBG("CDR data available: %zu bytes", s_nrf70_fw_stats_blob_size);
	return true;
}

/**
 * @brief Read CDR data at specified offset
 */
static bool read_data_cb(uint32_t offset, void *buf, size_t buf_len)
{
	if (offset != s_read_offset) {
		LOG_WRN("Unexpected read offset: %u vs %zu", offset, s_read_offset);
		/* Reset and try to continue */
		s_read_offset = offset;
	}

	if (offset >= s_nrf70_fw_stats_blob_size) {
		LOG_DBG("Read complete");
		return false;
	}

	size_t remaining = s_nrf70_fw_stats_blob_size - offset;
	size_t copy_len = (buf_len < remaining) ? buf_len : remaining;

	memcpy(buf, &s_nrf70_fw_stats_blob[offset], copy_len);
	s_read_offset += copy_len;

	LOG_DBG("Read %zu bytes at offset %u", copy_len, offset);
	return true;
}

/**
 * @brief Called when CDR data has been fully read/uploaded
 */
static void mark_cdr_read_cb(void)
{
	LOG_INF("nRF70 FW stats CDR data uploaded successfully");

	/* Reset state for next collection */
	s_cdr_data_ready = false;
	s_nrf70_fw_stats_blob_size = 0;
	s_read_offset = 0;
	s_nrf70_fw_stats_metadata.data_size_bytes = 0;
}

/**
 * @brief Collect nRF70 firmware statistics into the blob buffer
 *
 * Uses direct FMAC API (nrf_wifi_sys_fmac_stats_get) like wifi_util.c does.
 * This provides ON-DEMAND stats collection without per-packet polling.
 *
 * @return 0 on success, negative error code on failure
 */
static int collect_nrf70_fw_stats(void)
{
	struct nrf_wifi_ctx_zep *ctx = &rpu_drv_priv_zep.rpu_ctx_zep;
	struct nrf_wifi_fmac_dev_ctx *fmac_dev_ctx = NULL;
	struct rpu_sys_op_stats stats;
	enum nrf_wifi_status status;
	int ret = 0;

	/* Lock the RPU context (same pattern as wifi_util.c) */
	k_mutex_lock(&ctx->rpu_lock, K_FOREVER);

	if (!ctx->rpu_ctx) {
		LOG_ERR("RPU context not initialized - WiFi not started?");
		ret = -ENODEV;
		goto unlock;
	}

	fmac_dev_ctx = ctx->rpu_ctx;

	LOG_DBG("Collecting nRF70 firmware statistics (direct FMAC API)...");

	/* Query RPU stats directly - same call as wifi_util.c:nrf_wifi_util_dump_rpu_stats() */
	memset(&stats, 0, sizeof(struct rpu_sys_op_stats));
	status = nrf_wifi_sys_fmac_stats_get(fmac_dev_ctx, 0, &stats);

	if (status != NRF_WIFI_STATUS_SUCCESS) {
		LOG_ERR("Failed to get RPU stats: %d", status);
		ret = -EIO;
		goto unlock;
	}

	/* Copy the firmware stats structure directly as the blob */
	size_t fw_stats_size = sizeof(stats.fw);
	if (fw_stats_size > NRF70_FW_STATS_BLOB_MAX_SIZE) {
		LOG_WRN("FW stats truncated: %zu > %d bytes", fw_stats_size, NRF70_FW_STATS_BLOB_MAX_SIZE);
		fw_stats_size = NRF70_FW_STATS_BLOB_MAX_SIZE;
	}

	memcpy(s_nrf70_fw_stats_blob, &stats.fw, fw_stats_size);
	s_nrf70_fw_stats_blob_size = fw_stats_size;

	LOG_DBG("Collected %zu bytes of nRF70 FW stats (UMAC+LMAC+PHY)", s_nrf70_fw_stats_blob_size);

unlock:
	k_mutex_unlock(&ctx->rpu_lock);
	return ret;
}

/**
 * @brief Initialize the nRF70 FW stats CDR module
 *
 * @return 0 on success, negative error code on failure
 */
int mflt_nrf70_fw_stats_cdr_init(void)
{
	static bool initialized = false;

	if (initialized) {
		LOG_WRN("nRF70 FW stats CDR already initialized");
		return -EALREADY;
	}

	/* Register CDR source with Memfault */
	if (!memfault_cdr_register_source(&s_nrf70_fw_stats_cdr_source)) {
		LOG_ERR("Failed to register nRF70 FW stats CDR source");
		return -EIO;
	}

	initialized = true;
	LOG_INF("nRF70 FW stats CDR module initialized");

	return 0;
}



/**
 * @brief Trigger collection of nRF70 FW stats for CDR upload
 *
 * Call this function to collect current nRF70 firmware statistics
 * and prepare them for upload to Memfault. The data will be uploaded
 * during the next Memfault data post operation.
 *
 * @return 0 on success, negative error code on failure
 */
int mflt_nrf70_fw_stats_cdr_collect(void)
{
	int err;

	if (s_cdr_data_ready) {
		LOG_WRN("Previous CDR data not yet uploaded, overwriting");
	}

	/* Reset state */
	s_cdr_data_ready = false;
	s_nrf70_fw_stats_blob_size = 0;
	s_read_offset = 0;

	/* Collect the stats */
	err = collect_nrf70_fw_stats();
	if (err) {
		LOG_ERR("Failed to collect nRF70 FW stats: %d", err);
		return err;
	}

	if (s_nrf70_fw_stats_blob_size == 0) {
		LOG_WRN("No nRF70 FW stats collected");
		return -ENODATA;
	}


	/* Mark data as ready for upload */
	s_cdr_data_ready = true;

	LOG_INF("nRF70 FW stats CDR ready for upload (%zu bytes)", s_nrf70_fw_stats_blob_size);

	return 0;
}

/**
 * @brief Check if nRF70 FW stats CDR data is pending upload
 *
 * @return true if data is waiting to be uploaded
 */
bool mflt_nrf70_fw_stats_cdr_is_pending(void)
{
	return s_cdr_data_ready;
}

/**
 * @brief Get the size of collected nRF70 FW stats
 *
 * @return Size in bytes, or 0 if no data collected
 */
size_t mflt_nrf70_fw_stats_cdr_get_size(void)
{
	return s_nrf70_fw_stats_blob_size;
}
```

## src/mflt_nrf70_fw_stats_cdr.h
```c
/*
 * Copyright (c) 2025 Nordic Semiconductor ASA
 *
 * SPDX-License-Identifier: LicenseRef-Nordic-5-Clause
 *
 * nRF70 Firmware Statistics CDR (Custom Data Recording) for Memfault
 * 
 * WARNING: Memfault CDR is limited to 1 upload per device per 24 hours!
 *          Enable Developer Mode in Memfault dashboard for higher limits.
 * 
 * TRIGGER: Button 1 short press ONLY - no automatic/periodic collection.
 */

#ifndef MFLT_NRF70_FW_STATS_CDR_H__
#define MFLT_NRF70_FW_STATS_CDR_H__

#include <stdbool.h>
#include <stddef.h>

/**
 * @brief Initialize the nRF70 FW stats CDR module
 * 
 * Registers the CDR source with Memfault. Should be called once
 * during application startup, after Memfault is initialized.
 * 
 * @return 0 on success
 * @return -EALREADY if already initialized
 * @return -EIO if registration failed
 */
int mflt_nrf70_fw_stats_cdr_init(void);

/**
 * @brief Trigger collection of nRF70 firmware stats for CDR upload
 * 
 * Collects current nRF70 WiFi firmware statistics (PHY, LMAC, UMAC)
 * as a binary blob. The data will be uploaded to Memfault during
 * the next data post operation (memfault_zephyr_port_post_data()).
 * 
 * The blob format matches the output of "net stats all hex-blob" and
 * can be parsed using: modules/lib/nrf_wifi/scripts/nrf70_fw_stats_parser.py
 * 
 * Note: Memfault limits CDR uploads to 1 per device per 24 hours.
 * Enable Developer Mode in Memfault dashboard for higher limits
 * during development.
 * 
 * @return 0 on success
 * @return -ENODEV if no network interface found
 * @return -ENOTSUP if vendor stats not supported
 * @return -ENODATA if no stats available
 * @return -EIO on other errors
 */
int mflt_nrf70_fw_stats_cdr_collect(void);

/**
 * @brief Check if nRF70 FW stats CDR data is pending upload
 * 
 * @return true if data is waiting to be uploaded
 * @return false if no pending data
 */
bool mflt_nrf70_fw_stats_cdr_is_pending(void);

/**
 * @brief Get the size of collected nRF70 FW stats
 * 
 * @return Size in bytes of the collected stats blob
 * @return 0 if no data collected
 */
size_t mflt_nrf70_fw_stats_cdr_get_size(void);

#endif /* MFLT_NRF70_FW_STATS_CDR_H__ */
```

## src/mflt_ota_triggers.h
```c
/*
 * Copyright (c) 2025 Nordic Semiconductor ASA
 *
 * SPDX-License-Identifier: LicenseRef-Nordic-5-Clause
 */

#pragma once

#include <zephyr/sys/util.h>

#ifdef __cplusplus
extern "C" {
#endif

/**
 * @brief Notify the OTA trigger thread that a manual check should be performed.
 *
 * Typically invoked from the button handler when the user presses button 2.
 */
void mflt_ota_triggers_notify_button(void);

/**
 * @brief Notify the OTA trigger thread that network connectivity is available.
 */
void mflt_ota_triggers_notify_connected(void);

#ifdef __cplusplus
}
#endif
```

## src/mflt_stack_metrics.h
```c
/*
 * Copyright (c) 2025 Nordic Semiconductor ASA
 *
 * SPDX-License-Identifier: LicenseRef-Nordic-5-Clause
 */

#ifndef MFLT_STACK_METRICS_H_
#define MFLT_STACK_METRICS_H_

#ifdef __cplusplus
extern "C" {
#endif

/**
 * @brief Initialize stack metrics monitoring for all system threads
 *
 * Registers various system threads for stack usage monitoring with Memfault.
 * Only available when CONFIG_MEMFAULT_NCS_STACK_METRICS is enabled.
 */
void mflt_stack_metrics_init(void);

#ifdef __cplusplus
}
#endif

#endif /* MFLT_STACK_METRICS_H_ */
```

## src/mflt_wifi_metrics.h
```c
#pragma once

#ifdef __cplusplus
extern "C" {
#endif

void mflt_wifi_metrics_collect(void);

#ifdef __cplusplus
}
#endif
```
